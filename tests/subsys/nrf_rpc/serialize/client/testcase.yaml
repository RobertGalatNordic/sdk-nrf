## tests/subsys/nrf_rpc/serialize/client/testcase.yaml
```yaml
tests:
  nrf_rpc.serialize.client:
    tags: nrf_rpc
    platform_allow: native_posix
    filter: CONFIG_NRF_RPC=y
    depends_on: mock_nrf_rpc 
```
